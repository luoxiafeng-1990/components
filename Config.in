## Config.in
```kconfig
config BR2_PACKAGE_COMPONENTS
	bool "components - Component Framework"
	help
	  Component framework provides a cross-platform abstraction layer
	  for framebuffer display operations. Includes LinuxFramebufferDevice,
	  VideoFile management, BufferManager for multi-threaded buffer handling,
	  and PerformanceMonitor for video playback testing.
	  
	  Features:
	  - Thread-safe buffer pool management with producer-consumer pattern
	  - Built-in video file producer thread
	  - Multi-buffer framebuffer display support
	  - Performance monitoring and statistics
	  
	  This package generates a standalone 'display_test' executable for testing
	  raw video file playback on framebuffer devices with multiple test modes.
	  
	  Requires: pthread (C++17)
```
